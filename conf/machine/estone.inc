## conf/machine/estone.inc
```bitbake
require estone-mirrors.inc
INHERIT += "image-buildinfo"

MACHINE_FEATURES += " pci bluetooth wifi"

IMX_DEFAULT_BSP = "nxp"

USE_VT = "0"

DEFAULTTUNE_mx8mm  ?= "cortexa53-crypto"

# Use i.MX Gstreamer Version
MACHINE_GSTREAMER_1_0_PLUGIN_mx8 = "imx-gst1.0-plugin"
PREFERRED_VERSION_gstreamer1.0_mx8 = "1.16.imx"
PREFERRED_VERSION_gstreamer1.0-plugins-base_mx8 = "1.16.imx"
PREFERRED_VERSION_gstreamer1.0-plugins-good_mx8 = "1.16.imx"
PREFERRED_VERSION_gstreamer1.0-plugins-bad_mx8 = "1.16.imx"

# Add VPU and Cortex M4/M7 firmware
MACHINE_FIRMWARE_append_mx8 = " \
	firmware-imx-vpu-imx8 \
	"

MACHINE_EXTRA_RDEPENDS += " \
	gptfdisk \
	hostapd \
	hdparm \
	imx-kobs \
	iw \
	kernel-modules \
	kmod \
	${@bb.utils.contains('DISTRO', 'b2qt', '', \
           bb.utils.contains('DISTRO_FEATURES', 'wayland', 'networkmanager', \
                                                       '', d), d)} \
	packagegroup-tools-bluetooth \
	bluez-alsa \
	pm-utils \
	rng-tools \
	wpa-supplicant \
	wireless-regdb-static \
"

IMAGE_FSTYPES = "tar.gz wic.gz tar.bz2"

# Wayland based distros add systemd to DISTRO_FEATURES
# Remove sysvinit or systemd based on DISTRO_FEATURES to avoid conflicts
DISTRO_FEATURES_BACKFILL_CONSIDERED_append = "${@bb.utils.contains('DISTRO_FEATURES', 'systemd', ' sysvinit', '', d)}"
DISTRO_FEATURES_BACKFILL_CONSIDERED_append = "${@bb.utils.contains('DISTRO_FEATURES', 'sysvinit', ' systemd', '', d)}"

# Use bluez-alsa instead of pulseaudio
DISTRO_FEATURES_BACKFILL_CONSIDERED_append = " pulseaudio"
```

## conf/machine/imx8mm-est-4710.conf
```bitbake
#@TYPE: Machine
#@NAME: ESTONE IMX8MM-EST-4710
#@SOC: i.MX8MM
#@DESCRIPTION: Machine configuration for ESTONE IMX8MM-EST-4710
#@MAINTAINER: Cesar Hernandez <cesar.hernandez@estonetech.com>
#
# http://www.estonetech.com

MACHINEOVERRIDES =. "mx8:mx8m:mx8mm:"
require conf/machine/include/imx-base.inc
require conf/machine/include/tune-cortexa53.inc

require estone.inc

IMX_DEFAULT_BSP = "nxp"

MACHINE_FEATURES += " pci wifi bluetooth optee qca9377"

KERNEL_DEVICETREE = " \
	freescale/imx8mm-ddr4-evk.dtb \
	freescale/imx8mm-ddr4-evk-revb.dtb \
	freescale/imx8mm-ddr4-evk-revb-rm67191.dtb \
	freescale/imx8mm-ddr4-evk-rm67191.dtb \
	freescale/imx8mm-evk-ak4497.dtb \
	freescale/imx8mm-evk-ak5558.dtb \
	freescale/imx8mm-evk-audio-tdm.dtb \
	freescale/imx8mm-evk.dtb \
	freescale/imx8mm-evk-inmate.dtb \
	freescale/imx8mm-evk-revb.dtb \
	freescale/imx8mm-evk-rm67191.dtb \
	freescale/imx8mm-evk-root.dtb \
	freescale/imx8mm-evk-rpmsg.dtb \
"

UBOOT_CONFIG ??= "sd"
UBOOT_CONFIG[sd] = "imx8mm_evk_config,sdcard"
UBOOT_CONFIG[fspi] = "imx8mm_evk_fspi_defconfig"
UBOOT_CONFIG[mfgtool] = "imx8mm_evk_config"
SPL_BINARY = "spl/u-boot-spl.bin"

# Set DDR FIRMWARE
DDR_FIRMWARE_NAME = "lpddr4_pmu_train_1d_imem.bin lpddr4_pmu_train_1d_dmem.bin lpddr4_pmu_train_2d_imem.bin lpddr4_pmu_train_2d_dmem.bin"

# Set u-boot DTB
UBOOT_DTB_NAME = "imx8mm-evk.dtb"

# Set imx-mkimage boot target
IMXBOOT_TARGETS = "${@bb.utils.contains('UBOOT_CONFIG', 'fspi', 'flash_evk_flexspi', 'flash_evk', d)}"

# Set Serial console
SERIAL_CONSOLES = "115200;ttymxc1"

LOADADDR = ""
UBOOT_SUFFIX = "bin"
UBOOT_MAKE_TARGET = ""
IMX_BOOT_SEEK = "33"

OPTEE_BIN_EXT = "8mm"

# Add additional firmware
MACHINE_FIRMWARE_append = " linux-firmware-ath10k"
```
